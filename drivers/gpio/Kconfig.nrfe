## drivers/gpio/Kconfig.nrfe
```kconfig
# Copyright (c) 2024 Nordic Semiconductor ASA
# SPDX-License-Identifier: Apache-2.0

config GPIO_NRFE
	bool "nRF eGPIO driver"
	default y
	depends on DT_HAS_NORDIC_NRF_EGPIO_ENABLED
	select NRFE_GPIO2 if HAS_HW_NRF_EGPIO2
	help
	  Enable eGPIO driver for nRF line of MCUs.
```

## modules/hal_nordic/nrfe/Kconfig
```kconfig
# Copyright (c) 2016 Nordic Semiconductor ASA
# SPDX-License-Identifier: Apache-2.0

config HAS_NRFE
	bool

menu "nrfe drivers"
	depends on HAS_NRFE

config NRFE_GPIO
	bool

config NRFE_GPIO2
	bool "eGPIO2 driver instance"
	depends on $(dt_nodelabel_has_compat,egpio2,$(DT_COMPAT_NORDIC_NRF_EGPIO))
	select NRFE_GPIO

endmenu # "nrfe drivers"
```

## samples/basic/blinky/sample.yaml
```yaml
sample:
  name: Blinky Sample
tests:
  sample.basic.blinky:
    tags:
      - LED
      - gpio
    filter: dt_enabled_alias_with_parent_compat("led0", "gpio-leds")
    depends_on: gpio
    harness: led
    integration_platforms:
      - frdm_k64f

  sample.basic.blinky.egpio:
    platform_allow: nrf54l15pdk/nrf54l15/cpuapp
    integration_platforms:
      - nrf54l15pdk/nrf54l15/cpuapp
    tags:
      - LED
      - gpio
      - ipc
    filter: dt_enabled_alias_with_parent_compat("led4", "gpio-leds")
    depends_on: gpio
    harness:
      - console
      - led
    harness_config:
      type: multi_line
      ordered: false
      regex:
        - "host: IPC-service HOST demo started"
        - "host: Ep bounded"
        - "host: Perform sends for"
        - "host: Sent"
        - "host: Received"
        - "host: IPC-service HOST demo ended"
    extra_args:
      blinky_SNIPPET=nordic-flpr
      remote_CONFIG_MULTITHREADING=n
    sysbuild: true
```
